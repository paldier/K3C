/dts-v1/;

/*****************************************************************
** Include a chip configuration file                             
*****************************************************************/
/include/ "xrx500_bootcore.dtsi"

/ {
      model = "GRX350 ANYWAN BOOTCORE (MIPS 4Kec)";

};
