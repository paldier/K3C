/dts-v1/;

/include/ "xrx500_bootcore.dtsi"

/ {
        model = "GRX500 EVM BootCore Platform";

	chosen {
		bootargs-append = "console=ttyLTQ0,9600n8r root=/dev/ram rw loglevel=8"; 
        };

       	memory@0 {
             	name = "memory";
              	device_type = "memory";
            	reg = <0xE000000 0x2000000>;
	};
};
