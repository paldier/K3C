/dts-v1/;

/include/ "HAPS_BOOTCORE.dtsi"

/ {
        model = "HAPS Platform";

	chosen {
		bootargs-append = "console=ttyLTQ0,9600n8r root=/dev/ram rw loglevel=8"; 
        };

       	memory@0 {
             	name = "memory";
              	device_type = "memory";
            	reg = <0x0 0x1000000>;
	};
};
