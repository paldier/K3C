## ugw/target/linux/lantiq/image/Config.in
```kconfig
config TARGET_UBI_MTD_SUPPORT
	bool "Images on UBI mtd layer"
	depends on !TARGET_ROOTFS_INITRAMFS && UBOOT_CONFIG_BOOT_FROM_NAND && (TARGET_ROOTFS_SQUASHFS || TARGET_ROOTFS_JFFS2 || TARGET_ROOTFS_UBIFS)
	select PACKAGE_kmod-ubi_mtd
	select UBOOT_CONFIG_CMD_UBI
	select UBOOT_CONFIG_CMD_MTDPARTS
	select UBOOT_CONFIG_GZIP
	select UBOOT_CONFIG_ZLIB
	select UBOOT_CONFIG_RBTREE
	select UBOOT_CONFIG_LZO
	select UBOOT_CONFIG_LZMA
	select PACKAGE_mtd-utils
	select PACKAGE_mtd-utils-ubiupdatevol
	select PACKAGE_mtd-utils-ubirmvol
	select PACKAGE_mtd-utils-ubirename
	select PACKAGE_mtd-utils-ubinfo
	select PACKAGE_mtd-utils-ubimkvol
	select PACKAGE_mtd-utils-ubiattach
	select PACKAGE_mtd-utils-flash-erase
	select PACKAGE_mtd-utils-flash-eraseall
	select PACKAGE_mtd-utils-flash-lock
	select PACKAGE_mtd-utils-flash-unlock
	select PACKAGE_mtd-utils-nanddump
	select PACKAGE_mtd-utils-nandtest
	select PACKAGE_mtd-utils-nandwrite
	help
	   This enables ubi support on Kernel. You may need to add ubi support on uboot for this feature.

config TARGET_ROOTFS_DATAFS_SIZE
	string
	prompt "Specify the Data Volume size (In Megabytes MiB)"
	depends on TARGET_UBI_MTD_SUPPORT
	default "20MiB"
	help
	  Creating data volume helps in adding run time persistent data / Use as a firmware download location
          / Media Database / Use for persistent overlay filesystem.

  choice
	prompt "Select a filesystem for Data Volume"
	depends on TARGET_UBI_MTD_SUPPORT
	help
	  Choose a filesystem to enable and mount the data volume on target

	config TARGET_DATAFS_JFFS2
	  bool "jffs2"
	  select PACKAGE_kmod-jffs2
	  help
	    Enable and mount JFFS2 on data volume on target

	config TARGET_DATAFS_UBIFS
	  bool "ubifs"
	  select PACKAGE_kmod-ubifs
	  help
	    Enable and mount UBIFS on data volume on target

	config TARGET_DATAFS_NONE
	  bool "None"
	  help
	    No data volume needed

  endchoice

config TARGET_ROOTFS_DATAFS_OVERLAY
	bool "Data Volume Overlay on Rootfs"
	depends on TARGET_UBI_MTD_SUPPORT && TARGET_ROOTFS_SQUASHFS && (TARGET_DATAFS_JFFS2 || TARGET_DATAFS_UBIFS)
	select BUSYBOX_CONFIG_PIVOT_ROOT
	help
	  Create an overlay fs (using mini_fo) with data volume. To activate overlay, add 'do_overlay' flag
	  in the kernel command line. Refer /etc/preinit for more details.

config TARGET_ROOTFS_IMAGE_PHYSICAL_ERASE_SIZE
	string
	prompt "Physical nand erase size in kilobytes(k) for NAND images"
	depends on !TARGET_ROOTFS_INITRAMFS && UBOOT_CONFIG_BOOT_FROM_NAND
	help
	  Physical nand erase size to create nand based images. Refer NAND Chip spec to get this value.

config KERNEL_LANTIQ_IMAGE_EXTRA_CHECKS
	bool "Enable image extra checks"
	select UBOOT_CONFIG_LTQ_IMAGE_EXTRA_CHECKS
	help
	  Enable image extra checks to validate images while flashing

config LANTIQ_OPENWRT_FIRMWARE
	bool "Openwrt firmware build"
	select PACKAGE_kmod-lantiq-wrt-image
	default n
	help
	  Build openwrt firmware
```
