## ugw/feeds_opensrc/packages/upnpdm/config/Config.in
```kconfig
config FEATURE_GHN_DATA_MODEL
	bool 'Ghn data model support'
	default n
	help
		Support for Ghn data model defined by broadband forum
```

## ugw/target/linux/intel-xway/files/drivers/crypto/lantiq_deu/Kconfig
```kconfig
menuconfig  CRYPTO_DEV_LTQ_DEU
    bool "Support for Lantiq DEU drivers"
    depends on CRYPTO_DEV_LANTIQ_DEU
    select CRYPTO_ALGAPI2
    default y
    help
      Will support Lantiq DEU HW Crypto
      If you are unsure, say M. The compiled module will be
      called ltqdeu.ko

if CRYPTO_DEV_LTQ_DEU

config DES_CRYPTO_SEL
    bool "Lantiq DEU driver for DES algorithm"
	select CRYPTO_LTQ_ASYNC_DES if CRYPTO_LTQ_ASYNC_MODE
	select CRYPTO_DEV_LTQ_DES if !CRYPTO_LTQ_ASYNC_MODE
	default y

config AES_CRYPTO_SEL
    bool "Lantiq DEU driver for AES algorithm"
    select CRYPTO_LTQ_ASYNC_AES if CRYPTO_LTQ_ASYNC_MODE
    select CRYPTO_DEV_LTQ_AES if !CRYPTO_LTQ_ASYNC_MODE
	default y

config CRYPTO_LTQ_ASYNC_MODE
    bool "Run AES/DES algorithm in asynchronous mode"
	depends on (DES_CRYPTO_SEL || AES_CRYPTO_SEL)
    select CRYTO_ABLKCIPHER
	select CRYPTO_DEV_LTQ_DMA
	default n

config CRYPTO_DEV_LTQ_DES
    bool "DEU driver for DES algorithm"
    depends on DES_CRYPTO_SEL && !(CRYPTO_LTQ_ASYNC_MODE)
    help
     Use Lantiq DEU for DES/3DES algorithm.
     If unsure say N. The compiled module will be
     called ltqdeu-des.ko

config CRYPTO_DEV_LTQ_AES
    bool "DEU driver for AES algorithm"
    depends on AES_CRYPTO_SEL && !(CRYPTO_LTQ_ASYNC_MODE)
    help
      Use Lantiq DEU for AES algorithm.
      If unsure say N. The compiled module will be
      called ltqdeu-aes.kop

config CRYPTO_LTQ_ASYNC_DES
    bool "DEU driver for DES in Asynchronous Block Cipher mode"
    depends on DES_CRYPTO_SEL && CRYPTO_LTQ_ASYNC_MODE

config CRYPTO_LTQ_ASYNC_AES
    bool "DEU driver for AES in Asynchronous Block Cipher mode"
    depends on AES_CRYPTO_SEL && CRYPTO_LTQ_ASYNC_MODE

config CRYPTO_DEV_LTQ_ARC4
    bool "Lantiq DEU driver for ARC4 algorithm"
    depends on CRYPTO_DEV_LTQ_DEU
    select CRYPTO_BLKCIPHER
    default y
    help
          Use Lantiq DEU for ARC4 algorithm.
          If unsure say N. The compiled module will be
          called ltqdeu-arc4.ko

config CRYPTO_DEV_LTQ_SHA1
    bool "Lantiq DEU driver for SHA1 algorithm"
    depends on CRYPTO_DEV_LTQ_DEU
    select CRYPTO_HASH
    default y
    help
     Use Lantiq DEU for SHA1 algorithm.
     If unsure say N. The compiled module will be
     called ltqdeu-sha1.ko

config CRYPTO_DEV_LTQ_MD5
    bool "Lantiq DEU driver for MD5 algorithms"
    depends on CRYPTO_DEV_LTQ_DEU
    select CRYPTO_HASH
    default y
    help
     Use Lantiq DEU for MD5 algorithm.
     If unsure say N. The compiled module will be
     called ltqdeu-md5.ko

config CRYPTO_DEV_LTQ_SHA1_HMAC
    bool "Lantiq DEU driver for SHA1_HMAC algorithm"
    depends on CRYPTO_DEV_LTQ_DEU 
    select CRYPTO_HASH
    default y
    help
     Use Lantiq DEU for SHA1_HMAC algorithm.
     If unsure say N. The compiled module will be
     called ltqdeu-sha1_hmac.ko

config CRYPTO_DEV_LTQ_MD5_HMAC
    bool "Lantiq DEU driver for MD5_HMAC algorithms"
    depends on CRYPTO_DEV_LTQ_DEU
    select CRYPTO_HASH
    default y
    help
     Use Lantiq DEU for MD5_HMAC algorithm.
     If unsure say N. The compiled module will be
     called ltqdeu-md5_hmac.ko

config CRYPTO_DEV_LTQ_DMA
    bool "Run DEU over DMA interface"
    depends on CRYPTO_DEV_LTQ_DEU
    default n
    help
      Use the DMA Interface for all DEU algorithms.
      Only recommended for large data blocks!
      If unsure say N.

#config CRYPTO_DEV_POLL_DMA
#    bool "Run DEU in DMA Polling mode"
#    depends on CRYPTO_DEV_DMA && !(CRYPTO_ASYNC_AES) && !(CRYPTO_ASYNC_DES)
#    default y
#    help
#        Uses polling mode during DMA transactions. If unsure, leave this to enabled
#        by def.

#config CRYPTO_DEV_PWR_SAVE_MODE
#   bool "Enable COC (power save mode) for DEU module"
#   depends on CRYPTO_DEV_LTQ_DEU
#   default n
#   help
#      Check this item to run DEU in CoC mode (power saving mode) 
    

config CRYPTO_DEV_LTQ_TCRYPT
    tristate "Lantiq modified tcrypt test"
    depends on CRYPTO_DEV_LTQ_DEU
    select CRYPTO_BLKCIPHER
    select CRYPTO_AEAD2
    select CRYPTO_HASH2
    select CRYPTO_BLKCIPHER2
    select CRYPTO_PCOMP
    default m
    help
      y for testing of DEU algorithms without root filesystem.
      m for testing module.

config CRYPTO_DEU_PERFORMANCE
	bool "Configure DEU for Performance"
	default n

config CRYPTO_DEV_SPEED_TEST
    bool

config CRYPTO_SPEED_TEST
    tristate "Tcrypt speed test cases"
    depends on CRYPTO_DEV_LTQ_TCRYPT
    select CRYPTO_DEV_SPEED_TEST
	select CRYPTO_DEU_PERFORMANCE
    default n
    help
      Extended speed test to measure the performance of DEU drivers.
endif
```

## ugw/target/linux/lantiq/files/drivers/net/ethernet/lantiq/switch-api/Kconfig
```kconfig
#
# switch api configuration
#
config LTQ_ETHSW_API
    tristate "Lantiq Ethernet Switch API"
    default y
    help
    Support for Lantiq Ethernet Switch API.

menu LTQ_GSW_API_OPTIONS
 
config LTQ_8021X
	depends on (LTQ_ETHSW_API && ((SOC_XWAY) || (SOC_GRX500) || (X86_INTEL_CE2700)))
	default y
	bool "Support LTQ ETHSW 802.1X Switch API's"
    help
    Supported Lantiq Switch API for 802.1X features.

config LTQ_MULTICAST
	depends on (LTQ_ETHSW_API && ((SOC_XWAY) || (SOC_GRX500) || (X86_INTEL_CE2700)))
	default y
	bool "Support LTQ ETHSW MULTICAST Switch API's"
    help
    Supported Lantiq Switch API for multicast features.
    
config LTQ_QOS
	depends on (LTQ_ETHSW_API && ((SOC_XWAY) || (SOC_GRX500) || (X86_INTEL_CE2700)))
	default y
	bool "Support LTQ ETHSW QOS Switch API's"
    help
    Supported Lantiq Switch API for  Quality of Service (QoS) features.
    
config LTQ_STP
	depends on (LTQ_ETHSW_API && ((SOC_XWAY) || (SOC_GRX500) || (X86_INTEL_CE2700)))
	default y
	bool "Support LTQ ETHSW STP Switch API's"
    help
    Supported Lantiq Switch API for Spanning  Tree  Protocol(STP) features.
    
config LTQ_VLAN
	depends on (LTQ_ETHSW_API && ((SOC_XWAY) || (SOC_GRX500) || (X86_INTEL_CE2700)))
	default y
	bool "Support LTQ ETHSW VLAN Switch API's"
    help
    Supported Lantiq Switch API for VLAN features.

config LTQ_WOL
	depends on (LTQ_ETHSW_API && ((SOC_XWAY) || (SOC_GRX500) || (X86_INTEL_CE2700)))
	default y
	bool "Support LTQ ETHSW WOL Switch API's"
    help
    Supported Lantiq Switch API for Wake-On-Lan(WOL) features.

config LTQ_PMAC
	depends on (LTQ_ETHSW_API && ((SOC_XWAY) || (SOC_GRX500) || (X86_INTEL_CE2700)))
	default y
	bool "Support LTQ ETHSW PMAC Switch API's"
    help
    Supported Lantiq Switch API for PMAC Configuration features.

config LTQ_RMON
	depends on (LTQ_ETHSW_API && ((SOC_XWAY) || (SOC_GRX500) || (X86_INTEL_CE2700)))
	default y
	bool "Support LTQ ETHSW RMON Switch API's"
    help
    Supported Lantiq Switch API for RMON counter features.

endmenu
```

## ugw/target/linux/lantiq/files/drivers/net/lantiq_ppa/Kconfig
```kconfig
config LTQ_PPA
	bool "PPA Acceleration Package"
	depends on ETHERNET
	default n
	help
	  Acceleration Package Support

choice
   prompt "PPA Platform Selection"
   default LTQ_PPA_XRX330
   
   config LTQ_PPA_XRX100
      depends on LTQ_PPA
      bool "xRX100"

   config LTQ_PPA_XRX200
      depends on LTQ_PPA
      bool "xRX200"

   config LTQ_PPA_XRX300
      depends on LTQ_PPA
      bool "xRX300"
   
   config LTQ_PPA_XRX330
      depends on LTQ_PPA
      bool "xRX330"

   config LTQ_PPA_GRX500
      depends on LTQ_PPA
      bool "GRX500"

   config PPA_PUMA7
      depends on LTQ_PPA
      bool "X86_PUMA7"

endchoice

config LTQ_PPA_API
	tristate "PPA Acceleration Package - Kernel APIs"
	depends on LTQ_PPA && LTQ_PPA_DATAPATH
	default y
	help
	  PPA APIs and Kernel Hookup

config LTQ_MINI_JUMBO_FRAME_SUPPORT
	tristate "Mini Jumbo Frame support"
	depends on LTQ_PPA 
	default n
	help
	  Mini Jumbo Frame support


config LTQ_PPA_API_DIRECTPATH
	bool "Direct Path Support for PPA API"
	depends on LTQ_PPA_API
	default y
	help
	  Direct Path Support (e.g. WLAN) for PPA API

config LTQ_PPA_API_DIRECTPATH_BRIDGING
	bool "Bridging Support in Direct Path"
	depends on LTQ_PPA_API_DIRECTPATH
	default y
	help
	  Let PPA accelerate bridging traffic. (Not good performance in D4/A4)

config LTQ_PPA_API_DIRECTPATH_HAS_NEW_API
        bool "Support for Extended Direct Path API"
        depends on LTQ_PPA_API_DIRECTPATH
        default y
        help
          Let PPA accelerate extended API's.

config PPA_API_DIRECTCONNECT
    bool "Direct Connect Support for PPA API"
    depends on LTQ_PPA_API && LTQ_PPA_GRX500
    default y
    help
      Let PPA accelerate DirectConnect traffic.

config LTQ_PPA_HAL_SELECTOR
          bool "PPA HAL Selector support"
		  depends on LTQ_PPA_API && (LTQ_PPA_GRX500 || PPA_PUMA7)
          default y
          help
            HAL selector enables usage of multiple HAL layers and there by supports mutiple accleration engines

config PPA_PUMA_HAL
	tristate "PPA PUMA hal"
	depends on X86_PUMA7
	default n
	help
		PPA PUMA HAL  

config LTQ_PPA_PAE_HAL
	tristate "PPA PAE HAL - kernel APIs"
	depends on LTQ_PPA && LTQ_PPA_GRX500
	default y
	help
	    PAE HAL APIs support	

config LTQ_PPA_LRO
	tristate "GRX500 LRO support in PPA"
	depends on LTQ_PPA && LTQ_PPA_GRX500 && LTQ_TOE_DRIVER
	default y
	help
	    GRX500 LRO hookup in PPA	

config LTQ_PPA_TMU_HAL
	tristate "PPA TMU HAL - kernel APIs"
	depends on LTQ_PPA && LTQ_PPA_GRX500
	default y
	help
	    TMU HAL APIs support	

config LTQ_PPA_TMU_MIB_SUPPORT
        tristate "PPA TMU HAL - kernel APIs"
        depends on LTQ_PPA && LTQ_PPA_GRX500
        default y
        help
            TMU HAL MIB APIs support

config LTQ_PPA_MPE_HAL
	tristate "PPA MPE HAL - kernel APIs"
	depends on LTQ_PPA && LTQ_PPA_GRX500
	default n
	help
	    MPE HAL APIs support	

config LTQ_PPA_MPE_IP97
	tristate "LTQ PPA MPE IP97 Support"
	depends on LTQ_PPA && LTQ_PPA_GRX500
	default n
	help
	   LTQ PPA MPE IP97 Support

config LTQ_PPA_COC_SUPPORT
	tristate "PPA CoC Support - kernel APIs"
	depends on LTQ_PPA && LTQ_PPA_GRX500
	default n
	help
	    PPA CoC support	



config LTQ_BRIDGE_LEARNING
	bool "Learn bridge sessions in PPA"
	depends on LTQ_PPA
	default y
	help
	    PPA - Learn bridge sessions in PPA

config LTQ_PPA_HANDLE_CONNTRACK_SESSIONS
          bool "Handle Session Limit"
          depends on LTQ_PPA_API
          default n
          help
             Session limiting support based on session criteria ( priority and threshold )

choice
	prompt "Software TX Queue"
	depends on LTQ_PPA_API_DIRECTPATH
	default LTQ_PPA_DIRECTPATH_TX_QUEUE_NONE

config LTQ_PPA_DIRECTPATH_TX_QUEUE_NONE
	bool "No Support"
	help
	  Do not support Directpath Software TX Queue.

config LTQ_PPA_DIRECTPATH_TX_QUEUE_SIZE
	bool "Queue Length - 1524 x 50 bytes"
	help
	  TX queue length is counted in total bytes of all packets in queue.
	  It provides better performance while handling burst traffic, if the
	  size of packets is random. Default value is 1524 x 50 bytes and can
	  be changed with parameter "directpath_tx_queue_size" passed in kernel
	  command line or loadable module parameter.

config LTQ_PPA_DIRECTPATH_TX_QUEUE_PKTS
	bool "Queue Length - 50 packets"
	help
	  TX queue length is counted in number of packets in queue. It provides
	  less overhead with acceptable performance while handling burst
	  traffic. Default value is 50 packets and can be changed with parameter
	  "directpath_tx_queue_pkts" passed in kernel command line or loadable
	  module parameter.
config LTQ_PPA_DIRECTPATH_TX_IMQ
	bool "Use IMQ for Directpath Rateshaping"
	help
	  Use IMQ to do Directpath Rateshaping to solve burst issue
endchoice

config LTQ_PPA_API_DIRECTPATH_TASKLET
	bool "Directpath use tasklet on TX queue"
	depends on LTQ_PPA_API_DIRECTPATH && (LTQ_PPA_DIRECTPATH_TX_QUEUE_SIZE || LTQ_PPA_DIRECTPATH_TX_QUEUE_PKTS)
	help
        Directpath use tasklet to send frames from registered device.

config LTQ_PPA_API_PROC
	tristate "Proc Filesystem Support for PPA API"
	depends on LTQ_PPA_API
	default y
	help
	  Proc Filesystem Support for PPA API

config LTQ_PPA_MFE
        bool "Multiple Filed Classification and Vlan Editing"
        depends on LTQ_PPA_API
        default n
        help
          Multiple Field Classification and Vlan Editing feature PPA API

config LTQ_PPA_QOS
        bool "QOS"
        depends on LTQ_PPA_API
        default y
        help
          QOS support

config LTQ_PPA_QOS_WFQ
        bool "QOS WFQ"
        depends on LTQ_PPA_QOS
        default y
        help
          QOS WFQ support

config LTQ_PPA_QOS_RATE_SHAPING
        bool "QOS Rate Shaping"
        depends on LTQ_PPA_QOS
        default y
        help
          QOS Rate Shaping support

config LTQ_PPA_IPv6_ENABLE
	bool "PPA IPv6 support"
	depends on LTQ_PPA_API
	default y

config LTQ_PPA_DATAPATH
	tristate "PPA Acceleration Package - Data Path Driver"
	depends on LTQ_PPA
	default y
	select LTQ_ETH_FRAMEWORK
	help
	  PPA Low Level Driver (Data Path)

menu "Package Selection"
	depends on LTQ_PPA_DATAPATH

config LTQ_PPA_A5
	bool "PPA A5 Package <MII0/1 + ATM>"
   depends on LTQ_PPA_XRX100 || LTQ_PPA_XRX200 || LTQ_PPA_XRX300
	default n

config LTQ_PPA_D5
	bool "PPA D5 Package <MII0/1>"
   depends on LTQ_PPA_XRX100 || LTQ_PPA_XRX200 || LTQ_PPA_XRX300 || LTQ_PPA_XRX330
	default n

config LTQ_PPA_E5
	bool "PPA E5 Package <MII0/1 + PTM>"
   depends on LTQ_PPA_XRX100 || LTQ_PPA_XRX200 || LTQ_PPA_XRX300
	default n

config LTQ_PPE_E5_OFFCHIP_BONDING
	bool "PPA E5 Off-chip Bonding Support"
	depends on LTQ_PPA_XRX200
	select LTQ_PPA_E5
	default n

config LTQ_PPA_A1
	bool "VRX218 ATM Module"
#	depends on VRX318_PCIE_EP && (LTQ_PPA_XRX200 || LTQ_PPA_XRX300)
	depends on (LTQ_PPA_XRX300 || LTQ_PPA_XRX330)
	select LTQ_PPA_D5
	default n

config LTQ_PPA_E1
	bool "VRX218 PTM Module"
#	depends on VRX318_PCIE_EP && (LTQ_PPA_XRX200 || LTQ_PPA_XRX300)
	depends on (LTQ_PPA_XRX300 || LTQ_PPA_XRX330)
	select LTQ_PPA_D5
	default n

endmenu

config SUPPORT_PMAC_FLOWCONTROL
	bool "Enable PMAC flow control"
	depends on LTQ_PPA_XRX300 || LTQ_PPA_XRX200 || LTQ_PPA_XRX330
	default n

config GRX390_MM_ENHANCE
	bool "Use GRX390 Memory Enhance feature,(GRX390 Only)"
	depends on LTQ_PPA_XRX330
	default n

config ACCL_11AC
	tristate "Support Acceleration Qualcomm 11ac"
	depends on GRX390_MM_ENHANCE
	default n

config VRX218_DSL_DFE_LOOPBACK
	bool "SmartPHY DSL DFE Loopback Mode (PPA Testing Only)"
	depends on LTQ_PPA_A1 || LTQ_PPA_E1
	default n

config DSL_DFE_LOOPBACK
	tristate "xRX300 DSL DFE Loopback Mode (PPA Testing Only)"
	depends on LTQ_PPA && LTQ_PPA_XRX300
	default n

config LOOP_ETH_DEV
	tristate "Loopback ETH Emulation Device(PPA Testing Only)"
	depends on LTQ_PPA
	default n

config LTQ_PORT_MIRROR
	bool "Port Mirror support (Debugging Feature)"
	depends on LTQ_PPA
	default y
	help
	  Port mirror support.

config PTM_VECTORING
	tristate "PTM Vectoring Error Report Support"
	default n

config LTQ_PPA_PORT_SEPARATION
	bool "Port Seperation support"
	default n
```

## ugw/target/linux/lantiq/files/drivers/net/lantiq_ppa/Kconfig.swaccl
```kconfig
config LTQ_PPA_API_SW_FASTPATH
          bool "Software Fastpath for PPA API"
          depends on LTQ_PPA_API
          default n
          help
            Software Fastpath Support for PPA API (To accelerate PPA sessions that are not in PPE)

config LTQ_PPA_TCP_LITEPATH
	bool "Local TCP traffic byepass"
	depends on LTQ_PPA_API_SW_FASTPATH
	default y
	help
	   Litepath for local TCP traffic (byepassing the l2 and netfilter hooks)
```
