## K3C/k3c_gpio_led/config/Config.in
```kconfig
config LTQ_GPIO_LED
   bool "Lantiq GPIO LED configure script"
   depends on PACKAGE_kmod-leds-gpio
   default y
   help
       This is a quite simple script to configure the (NETCORE) board GPIO LEDS
```

## K3C/wlan/wlan_wave_feed/lq-wave-300_5_x/config/Config.in
```kconfig
config FEATURE_LTQ_WAVE_500_PCIE
	depends on PACKAGE_ltq-wlan-wave_5_x
	bool 'Enable WAVE500 real chip support'
	help
	  Support for WAVE500 real chip (PCIE interface)

config FEATURE_LTQ_WAVE_500
	depends on PACKAGE_ltq-wlan-wave_5_x
	bool 'Enable WAVE500 FPGA support'
	help
	  Support for WAVE500 FPGA (AHB interface)

config FEATURE_LTQ_WAVE_AR10_SUPPORT
	depends on PACKAGE_ltq-wlan-wave_5_x
	bool 'Enable WAVE support for AR10'
	help
	  Support for WAVE on AR10 platforms

config FEATURE_LTQ_WAVE_STA
	bool 'Enable WAVE station support'
	help
	  Support for WAVE STA mode

config FEATURE_LTQ_WAVE_DEBUG_TFTP_BINS
	bool 'Enable usage of ls.txt file to load binaries'
	help
	  Suppport usage of ls.txt file to load binaries

config FEATURE_LTQ_WAVE_FGPA_DUMMY_PHY
	depends on PACKAGE_ltq-wlan-wave_5_x
	bool 'Set FPGA dummy phy'
	help
	  Support FPGA dummy phy

config FEATURE_LTQ_WAVE_500B
	depends on PACKAGE_ltq-wlan-wave_5_x
	bool 'Enable WAVE500B'
	default y
	help
	  Support for WAVE500B and HAPS70
```

## ugw/build/build_support/ltq-bootcore-build/config/Config.in
```kconfig
config XRX500_BOOTCORE_MODEL
	string
  prompt "xrx500 Bootcore Model name"
  default ""
  help
      Specify xrx500 Boot core model name for build
```

## ugw/feeds_opensrc/bootloaders/open_uboot/config/Kconfig
```kconfig
config LANTIQ_UBOOT_danube
	bool
	default y
	depends on ( TARGET_ltqcpe_danube || TARGET_ltqcpe_platform_danube || TARGET_lantiq_danube )

config LANTIQ_UBOOT_amazon_se
    bool
	default y
	depends on ( TARGET_ltqcpe_amazon_se || TARGET_ltqcpe_platform_amazon_se || TARGET_lantiq_ase )
			
config LANTIQ_UBOOT_ar9
    bool
    default y
    depends on ( TARGET_ltqcpe_ar9 || TARGET_ltqcpe_platform_ar9 || TARGET_lantiq_ar9 )

config LANTIQ_UBOOT_vr9
    bool
	default y
	depends on ( TARGET_ltqcpe_vr9 || TARGET_ltqcpe_platform_vr9 || TARGET_lantiq_xrx200 )
			
config LANTIQ_UBOOT_ar10
    bool
	default y
	depends on ( TARGET_ltqcpe_ar10 || TARGET_ltqcpe_platform_ar10 || TARGET_lantiq_xrx300 )
			
config LANTIQ_UBOOT_grx390
    bool
    default y
    select LANTIQ_UBOOT_ar10
	depends on ( TARGET_ltqcpe_platform_ar10_GRX390 || TARGET_lantiq_xrx330 )

config LANTIQ_UBOOT_hn1
    bool
    default y
    depends on ( TARGET_ltqcpe_hn1 || TARGET_ltqcpe_platform_hn1 || TARGET_lantiq_hn1 )
			
config LANTIQ_UBOOT_vbg400
    bool
    default y
    depends on ( TARGET_ltqcpe_platform_vbg400 )

config LANTIQ_UBOOT_grx500
    bool
    default y
    depends on ( TARGET_lantiq_xrx500 || TARGET_lantiq_xrx500_4kec || TARGET_intel_xway_xrx500 || TARGET_intel_xway_xrx500_4kec )


source package/feeds/ltq_feeds_uboot/open_uboot/config/scripts_platform/Kconfig
```
