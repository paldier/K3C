## ugw/feeds_opensrc/bootloaders/open_uboot/config/board/grx500/Kconfig
```kconfig
config UBOOT_CONFIG_DRIVER_GRX500
      bool
      default y

choice 
      prompt "Chipset Version"
      default UBOOT_CONFIG_GRX500_A11

config UBOOT_CONFIG_GRX500_A11
      bool "GRX500 version A11"

config UBOOT_CONFIG_GRX500_A21
      bool "GRX500 version A21"
endchoice

choice
	prompt "Board Specific"
	default UBOOT_CONFIG_BOARD_EASY350
	depends on UBOOT_CONFIG_GRX500_A21

config UBOOT_CONFIG_BOARD_EASY350
	bool "EASY350 Family Board"

config UBOOT_CONFIG_BOARD_EVM
	bool "GRX500 Evaluation Board"

endchoice

config UBOOT_CONFIG_GRX500_ROM_HEADER_BCH_CAP
       int
       default 40 if ( UBOOT_CONFIG_GRX500_A11 )
       default 8  if ( UBOOT_CONFIG_GRX500_A21 )  

config UBOOT_CONFIG_GRX500_BOOT_4KEC_ONLY
       bool "boot 4kec only"
       default n

menu "Memory configuration for Trusted OS"
choice 
    prompt "Memory reserved for TOS"
    default UBOOT_CONFIG_TOS_128M

config UBOOT_CONFIG_TOS_16M
	bool "16M for tos"

config UBOOT_CONFIG_TOS_32M
	bool "32M for tos"

config UBOOT_CONFIG_TOS_64M
	bool "64M for tos"

config UBOOT_CONFIG_TOS_128M
	bool "128M for tos"
endchoice

choice 
    prompt "DDR present in system"
    default UBOOT_CONFIG_DDR_512M

config UBOOT_CONFIG_DDR_256M
    bool "256M DDR"

config UBOOT_CONFIG_DDR_512M
	bool "512M DDR"

config UBOOT_CONFIG_DDR_1G
    bool "1G DDR"
endchoice

config UBOOT_CONFIG_FMT1_REG
	hex  
	default "0xFF002F00" if (UBOOT_CONFIG_DDR_256M  &&  UBOOT_CONFIG_TOS_16M)
	default "0xFE002E00" if (UBOOT_CONFIG_DDR_256M  &&  UBOOT_CONFIG_TOS_32M)
	default "0xFC002C00" if (UBOOT_CONFIG_DDR_256M  &&  UBOOT_CONFIG_TOS_64M)
	default "0xF8002800" if (UBOOT_CONFIG_DDR_256M  &&  UBOOT_CONFIG_TOS_128M)
	default "0xFF003F00" if (UBOOT_CONFIG_DDR_512M  &&  UBOOT_CONFIG_TOS_16M)
	default "0xFE003E00" if (UBOOT_CONFIG_DDR_512M  &&  UBOOT_CONFIG_TOS_32M)
	default "0xFC003C00" if (UBOOT_CONFIG_DDR_512M  &&  UBOOT_CONFIG_TOS_64M)
	default "0xF8003800" if (UBOOT_CONFIG_DDR_512M  &&  UBOOT_CONFIG_TOS_128M)
	default "0xFF005F00" if (UBOOT_CONFIG_DDR_1G  &&  UBOOT_CONFIG_TOS_16M)
	default "0xFE005E00" if (UBOOT_CONFIG_DDR_1G  &&  UBOOT_CONFIG_TOS_32M)
	default "0xFC005C00" if (UBOOT_CONFIG_DDR_1G  &&  UBOOT_CONFIG_TOS_64M)
	default "0xF8005800" if (UBOOT_CONFIG_DDR_1G  &&  UBOOT_CONFIG_TOS_128M)
endmenu

menu "MIPS and DDR Settings"
config UBOOT_CONFIG_GRX500_USE_DDR_PRECONFIG
       bool "use pre-config DDR setting" 
       default n

config UBOOT_CONFIG_GRX500_DDR_CONFIG_FILE
       string "ddr config file path"
       default "ddr.conf"
       depends on UBOOT_CONFIG_GRX500_USE_DDR_PRECONFIG

choice 
	prompt "DDR Type"
	default UBOOT_CONFIG_GRX500_DDR3
        depends on !UBOOT_CONFIG_GRX500_USE_DDR_PRECONFIG
	help
		Choose between DDR3/DDR2

config UBOOT_CONFIG_GRX500_DDR2
	bool "DDR2"

config UBOOT_CONFIG_GRX500_DDR3
	bool "DDR3"

endchoice

choice
	prompt "DDR Grade"
	default UBOOT_CONFIG_GRX500_667M_CL9
        depends on !UBOOT_CONFIG_GRX500_USE_DDR_PRECONFIG
	help
		This options list down the CAS-Latency and DDR frequency
		that the system will run on

config UBOOT_CONFIG_GRX500_400M_CL6
	bool "400Mhz CL6"

config UBOOT_CONFIG_GRX500_533M_CL6
	bool "533Mhz CL6"

config UBOOT_CONFIG_GRX500_533M_CL7
	bool "533Mhz CL7"

config UBOOT_CONFIG_GRX500_533M_CL8
	bool "533Mhz CL8"

config UBOOT_CONFIG_GRX500_667M_CL8
	bool "667Mhz CL8"

config UBOOT_CONFIG_GRX500_667M_CL9
	bool "667Mhz CL9"

config UBOOT_CONFIG_GRX500_667M_CL10
	bool "667Mhz CL10"

config UBOOT_CONFIG_GRX500_800M_CL9
	bool "800Mhz CL9"

config UBOOT_CONFIG_GRX500_800M_CL10
	bool "800Mhz CL10"

config UBOOT_CONFIG_GRX500_800M_CL11
	bool "800Mhz CL11"

endchoice

choice 
	prompt "DDR Density Configurations"
	default UBOOT_CONFIG_GRX500_256Mx16
        depends on !UBOOT_CONFIG_GRX500_USE_DDR_PRECONFIG
	help
		Choose the configuration of the DDR to determine the MAX size
		of the system DDR

config UBOOT_CONFIG_GRX500_32Mx16
	bool "32M x 16"

config UBOOT_CONFIG_GRX500_64Mx8
	bool "64M x 8"

config UBOOT_CONFIG_GRX500_64Mx16
	bool "64M x 16"

config UBOOT_CONFIG_GRX500_128Mx8
	bool "128M x 8"

config UBOOT_CONFIG_GRX500_128Mx16
	bool "128M x 16"

config UBOOT_CONFIG_GRX500_256Mx8
	bool "256M x 8"

config UBOOT_CONFIG_GRX500_256Mx16
	bool "256M x 16"

config UBOOT_CONFIG_GRX500_512Mx8
	bool "512M x 8"

config UBOOT_CONFIG_GRX500_512Mx16
	bool "512M x 16"

endchoice 

choice
	prompt "DDR Operating Burst Length"
	default UBOOT_CONFIG_GRX500_BL8
		depends on !UBOOT_CONFIG_GRX500_USE_DDR_PRECONFIG
	help
		Choose the operating burst length of the DDR

config UBOOT_CONFIG_GRX500_BL8
	bool "Configuration BL8"

config UBOOT_CONFIG_GRX500_BC4
	bool "Configuration BC4"

endchoice

menu "DDR Pre-Seed Rank 0 Value"
	depends on !UBOOT_CONFIG_GRX500_USE_DDR_PRECONFIG

config UBOOT_CONFIG_GRX500_1ST_SR0_VALUE
	int "Fist pre-seed value"
	default "24"

config UBOOT_CONFIG_GRX500_2ND_SR0_VALUE
	int "Second pre-seed value"
	default "24"
endmenu

menu "DDR Pre-Seed Rank 1 Value"
	depends on !UBOOT_CONFIG_GRX500_USE_DDR_PRECONFIG

config UBOOT_CONFIG_GRX500_1ST_SR1_VALUE
	int "First pre-seed value"
	default "24"

config UBOOT_CONFIG_GRX500_2ND_SR1_VALUE
	int "Second pre-seed value"
	default "24"
endmenu

choice 
	prompt "DDR Controller Speed (set as 1/2 DDR Grade/Speed)"
	default UBOOT_CONFIG_GRX500_DDR_CTRL_333M
        depends on !UBOOT_CONFIG_GRX500_USE_DDR_PRECONFIG
	help
		DDR Controller speed. It should be set at half the speed of the 
		intended frequency of the DDR

config UBOOT_CONFIG_GRX500_DDR_CTRL_200M
	bool "DDR Controller @ 200Mhz"
	
config UBOOT_CONFIG_GRX500_DDR_CTRL_333M
	bool "DDR Controller @ 333Mhz"

config UBOOT_CONFIG_GRX500_DDR_CTRL_400M
	bool "DDR Controller @ 400Mhz"

endchoice

config UBOOT_CONFIG_GRX500_CS0_ONLY
	bool "DDR is using CS0 only"
	default y
	depends on !UBOOT_CONFIG_GRX500_USE_DDR_PRECONFIG
	help
		Select if DDR config is only using CS0.
		If DDR config uses both CS0/CS1, un-select this option

config UBOOT_CONFIG_GRX500_ADDITIVE_LATENCY
	int "DDR Additive Latency CL 'N' value" 
	default "1"
        depends on !UBOOT_CONFIG_GRX500_USE_DDR_PRECONFIG
	help
		CL valid values: N [0, -1, -2]

comment "End of DDR configurations " 
	depends on !UBOOT_CONFIG_GRX500_USE_DDR_PRECONFIG

choice 
	prompt "MIPS CPS Speed"
	default UBOOT_CONFIG_GRX500_CPU_600M
        depends on !UBOOT_CONFIG_GRX500_USE_DDR_PRECONFIG
	help
		Choose the frquency at which MIPS Interaptive is running

config UBOOT_CONFIG_GRX500_CPU_600M
	bool "CPU running at 600Mhz"

config UBOOT_CONFIG_GRX500_CPU_800M
	bool "CPU running at 800Mhz"

config UBOOT_CONFIG_GRX500_CPU_1000M
	bool "CPU running at 1000Mhz"
	
config UBOOT_CONFIG_GRX500_CPU_1200M
	bool "CPU running at 1200Mhz"

endchoice


choice 
	prompt "CBM Frequency settings"
	default UBOOT_CONFIG_GRX500_CBM_FREQ_200M
        depends on !UBOOT_CONFIG_GRX500_USE_DDR_PRECONFIG
	help
		Sets the CBM frequency

config UBOOT_CONFIG_GRX500_CBM_FREQ_200M
	bool "CBM Frequency @ 200Mhz"

config UBOOT_CONFIG_GRX500_CBM_FREQ_300M
	bool "CBM Frequency @ 300Mhz"

config UBOOT_CONFIG_GRX500_CBM_FREQ_400M
	bool "CBM Frequency @ 400Mhz"

config UBOOT_CONFIG_GRX500_CBM_FREQ_480M
	bool "CBM Frequency @ 480Mhz"

config UBOOT_CONFIG_GRX500_CBM_FREQ_600M
	bool "CBM Frequency @ 600Mhz"

config UBOOT_CONFIG_GRX500_CBM_FREQ_800M
	bool "CBM Frequency @ 800Mhz"

config UBOOT_CONFIG_GRX500_CBM_FREQ_1200M
	bool "CBM Frequency @ 1200Mhz"

config UBOOT_CONFIG_GRX500_CBM_FREQ_2400M
	bool "CBM Frequency @ 2400Mhz"

endchoice

config UBOOT_CONFIG_GRX500_MIPS_ENDIAN_BE
	bool "Select to run MIPS in BE mode"
	default y
        depends on !UBOOT_CONFIG_GRX500_USE_DDR_PRECONFIG
	help
		Set MIPS to run in BE/LE

endmenu

menu "SWITCH OPTIONS"

choice 
	prompt "Interfaces"

config UBOOT_CONFIG_NETWORK_VIA_LAN
	bool "Network via LAN ports"
	select UBOOT_CONFIG_GRX500_PHY2
	select UBOOT_CONFIG_GRX500_PHY3
	select UBOOT_CONFIG_GRX500_PHY4
	select UBOOT_CONFIG_GRX500_PHY5

config UBOOT_CONFIG_NETWORK_VIA_WAN
	bool "Network via WAN port"
	select UBOOT_CONFIG_GRX500_PHY2
	select UBOOT_CONFIG_GRX500_PHY3
	select UBOOT_CONFIG_GRX500_PHY4
	select UBOOT_CONFIG_GRX500_PHY5
	select UBOOT_CONFIG_GRX500_PHY6F

endchoice

config UBOOT_CONFIG_GRX500_PHY2
	bool

config UBOOT_CONFIG_GRX500_PHY3
	bool

config UBOOT_CONFIG_GRX500_PHY4
	bool

config UBOOT_CONFIG_GRX500_PHY5
	bool

config UBOOT_CONFIG_GRX500_PHY6F
	bool

config UBOOT_CONFIG_GRX500_GPHY_FW_EMBEDDED
    bool "gphy firmware embedded"
    default y

config UBOOT_CONFIG_GRX500_GPHY_FW_ADDR
    hex
    default "0xa0220000" if ( UBOOT_CONFIG_BOOT_FROM_SPI )
    default "0xa0220000" if ( UBOOT_CONFIG_BOOT_FROM_NAND )
    depends on UBOOT_CONFIG_GRX500_GPHY_FW_EMBEDDED

config UBOOT_CONFIG_GRX500_EXTERN_GPHY_FW_ADDR
    hex "gphy firmware address"
    default "0xb0010000"
    depends on !UBOOT_CONFIG_GRX500_GPHY_FW_EMBEDDED

endmenu
```

## ugw/feeds_opensrc/bootloaders/open_uboot/config/board/hn1/Kconfig
```kconfig
config UBOOT_CONFIG_DRIVER_HN1
    bool
    default y

menu "CPU/DDR FREQUENCY"

choice 
    prompt "PLATFORM"
    default UBOOT_CONFIG_HNX100

config UBOOT_CONFIG_HNX100
    bool "HNX100"

config UBOOT_CONFIG_HNX200
    bool "HNX200(FUTURE USE)"

endchoice


choice 
    prompt "DDR TYPE SELECTION"
    default UBOOT_CONFIG_HN1_DDR2

config UBOOT_CONFIG_HN1_DDR1
    bool "DDR1"

config UBOOT_CONFIG_HN1_DDR2
    bool "DDR2"

endchoice

choice
    prompt "CPU AND RAM CONFIGURATION"
    default UBOOT_CONFIG_HN1_CPU_400M_RAM_200M

config UBOOT_CONFIG_HN1_CPU_200M_RAM_100M
    bool "200M/100M"
    depends on !UBOOT_CONFIG_HN1_DDR2    

config UBOOT_CONFIG_HN1_CPU_200M_RAM_200M
    bool "200M/200M"

config UBOOT_CONFIG_HN1_CPU_400M_RAM_200M
    bool "400M/200M"

endchoice

config UBOOT_CONFIG_ENABLE_POWER_MANAGEMENT
    bool "Enable power management(EXPERIMENTAL)"
	default n

config UBOOT_CONFIG_USE_DEFAULT_LOWPOWER_SETTING
    bool "USE DEFAULT LOWPOWER SETTING"
    default y
    depends on UBOOT_CONFIG_ENABLE_POWER_MANAGEMENT


config UBOOT_CONFIG_LOWPOWER_CONTROL
    hex 'LOWPOWER_CONTROL'
    default "0x14"
    depends on !UBOOT_CONFIG_USE_DEFAULT_LOWPOWER_SETTING
    depends on UBOOT_CONFIG_ENABLE_POWER_MANAGEMENT

config UBOOT_CONFIG_LOWPOWER_AUTO_ENABLE
    hex 'LOWERPOWER_AUTO_ENABLE'
    default "0x14"
    depends on !UBOOT_CONFIG_USE_DEFAULT_LOWPOWER_SETTING
    depends on UBOOT_CONFIG_ENABLE_POWER_MANAGEMENT

config UBOOT_CONFIG_LOWPOWER_POWER_DOWN_CNT
    hex 'LOWPOWER_POWER_DOWN_CNT'
    default "0x40"
    depends on !UBOOT_CONFIG_USE_DEFAULT_LOWPOWER_SETTING
    depends on UBOOT_CONFIG_ENABLE_POWER_MANAGEMENT

config UBOOT_CONFIG_LOWPOWER_SELF_REFRESH_CNT
    hex 'LOWPOWER_SELF_REFRESH_CNT'
    default "0x80"
    depends on !UBOOT_CONFIG_USE_DEFAULT_LOWPOWER_SETTING
    depends on UBOOT_CONFIG_ENABLE_POWER_MANAGEMENT

endmenu


menu "SWITCH OPTIONS"


config UBOOT_CONFIG_HN1_SW_PORT_1
    bool "USE PORT 1"
	default y

config UBOOT_CONFIG_HN1_SW_PORT1_GMII
    bool  
    depends on UBOOT_CONFIG_HN1_SW_PORT_1 && !UBOOT_CONFIG_HN1_SW_PORT_0b
    default y

config UBOOT_CONFIG_HN1_SW_PORT1_MIIRATE
   int
   depends on UBOOT_CONFIG_HN1_SW_PORT_1
   default 4
					 
config UBOOT_CONFIG_HN1_SW_PORT1_MIIMODE
    int
    depends on UBOOT_CONFIG_HN1_SW_PORT_1
    default 5 

config UBOOT_CONFIG_HN1_SW_PORT_0a
    bool "USE PORT 0a"
    default y
    depends on !UBOOT_CONFIG_HN1_SW_PORT_0b

choice
    prompt "INTERFACE"
    depends on UBOOT_CONFIG_HN1_SW_PORT_0a
    default UBOOT_CONFIG_HN1_SW_PORT0a_RGMII

config UBOOT_CONFIG_HN1_SW_PORT0a_RGMII
    bool "RGMII"
endchoice

config UBOOT_CONFIG_HN1_SW_PORT0a_MIIMODE
    int
    depends on UBOOT_CONFIG_HN1_SW_PORT_0a
    default 4

config UBOOT_CONFIG_HN1_SW_PORT0a_MIIRATE
    int
    depends on UBOOT_CONFIG_HN1_SW_PORT_0a
    default 4
			
config UBOOT_CONFIG_HN1_SW_PORT_0b
    bool "USE PORT 0b"
    default n
    
choice
    prompt "INTERFACE"
    depends on UBOOT_CONFIG_HN1_SW_PORT_0b
    default UBOOT_CONFIG_HN1_SW_PORT0b_MII

config UBOOT_CONFIG_HN1_SW_PORT0b_MII
    bool "MII"

endchoice       

config UBOOT_CONFIG_HN1_SW_PORT0b_MIIMODE
    int
    depends on UBOOT_CONFIG_HN1_SW_PORT_0b
    default 5

config UBOOT_CONFIG_HN1_SW_PORT0b_MIIRATE
    int
    depends on UBOOT_CONFIG_HN1_SW_PORT_0b
    default 4

config UBOOT_CONFIG_HN1_GPHY_FW_EMBEDDED
    bool "gphy firmware embedded"
    default y

config UBOOT_CONFIG_HN1_GPHY_FW_ADDR
    hex 'gphy firmware address'
    default "0xa0110000" if ( UBOOT_CONFIG_BOOT_FROM_SPI )
    default "0xa0120000" if ( UBOOT_CONFIG_BOOT_FROM_NAND )
    depends on UBOOT_CONFIG_HN1_SW_PORT_0b || UBOOT_CONFIG_HN1_SW_PORT_1
    depends on UBOOT_CONFIG_HN1_GPHY_FW_EMBEDDED

config UBOOT_CONFIG_HN1_EXTERN_GPHY_FW_ADDR
    hex "gphy firmware address"
    default "0xa0110000"
    depends on !UBOOT_CONFIG_HN1_GPHY_FW_EMBEDDED

config UBOOT_CONFIG_HN1_GPHY_DEBUG
    bool "DEBUG GPHY"
    default y
    depends on !UBOOT_CONFIG_NAND_FLASH
	
endmenu

config UBOOT_CONFIG_TUNE_DDR
    bool "DDR tuning support"
    default y

config UBOOT_CONFIG_DDR_TUNING_TEXT_BASE
    hex 
    default "0x9f280000"
    depends on UBOOT_CONFIG_TUNE_DDR

config UBOOT_CONFIG_ENABLE_CORE_DCDC
    bool "ENABLE CORE DCDC"
    default n

config UBOOT_CONFIG_ENABLE_DDR_DCDC
    bool "ENABLE DDR DCDC"
    default n

config UBOOT_CONFIG_POWER_DOWN_REGULATOR
    bool "POWER DOWN 2.5V REGULATOR"
    default n

config UBOOT_CONFIG_DEBUG
    bool "VERBOSE"
    default n

config UBOOT_CONFIG_FASTER_UART
    bool "USE 25x FASTER UART"
    default n
	
config UBOOT_CONFIG_USE_TANTOS_SWITCH
    bool "Use TANTOS chip as external switch connected to HNX over RGMII"
    default y
	
```

## ugw/feeds_opensrc/bootloaders/open_uboot/config/board/vbg400/Kconfig
```kconfig
#
# For a description of the syntax of this configuration file,
# see Linux Documentation
#
#

config UBOOT_CONFIG_DRIVER_VBG400
	bool "VBG400"
	default y

config UBOOT_CONFIG_VBG400_DDR_8BIT
	bool "8Bit DDR RAM"
	default n

config UBOOT_CONFIG_VBG400_MAC_GMAC_INDEX
	int "GMAC Index 0/1"
	default 0

config UBOOT_CONFIG_VBG400_MAC_INTERFACE_MODE
	int "Interface mode: 0=mii_gmii, 1=rgmii, 2=rmii"
	default 1

config UBOOT_CONFIG_MAC_MODE_REVERSED
	int "compile for REVERSED MODE"
	default 0

config UBOOT_CONFIG_VBG400_CHIPIT
	bool "compile for CHIPIT"
	default n

config UBOOT_CONFIG_VBG400_EVB
	bool "compile for evaluation board"
	default n

config UBOOT_CONFIG_MAC_DIV_CLOCK
	int "select div clock for MAC, 1 for PLL2, 0 for other"
	default 0

config UBOOT_CONFIG_VBG400_PHY_ADDR_GMAC_0
	int "select PHY address for GMAC0"
	default 0

config UBOOT_CONFIG_VBG400_PHY_ADDR_GMAC_1
	int "select PHY address for GMAC1"
	default 5
```

## ugw/feeds_opensrc/packages/br2684ctl/config/Config.in
```kconfig
config FEATURE_LTQ_VLAN
	bool 'WAN VLAN Tagging Support'
	help
	  Support for WAN VLAN Tagging
```

## ugw/feeds_opensrc/packages/ltq-cgroups/config/Config.in
```kconfig
config FEATURE_CGROUP_AFFINITY
        bool 'CGROUP set affinity for samba vsftpd'
	default y
        help
          Option to Set affinity for samba vsftpd
```

## ugw/feeds_opensrc/packages/procd/config/Config.in
```kconfig
config PROCD_LTQ_SPECIFIC_INIT
    bool 'Mount specific filesystems'
    default n
	help
		Lantiq specific file systems will be mounted

config PROCD_LTQ_SPECIFIC_LOG_REDIRECTION
	bool 'Log redirection to console'
	default n
	help
		Logs will be redirected to console or /var/log/messages file based on sl log level

config PROCD_LTQ_SPECIFIC_BYPASS_HANDLE_FIRMWARE
	bool 'Bypass firmware upgrade'
	default n
	help
		Firmware upgrade will be bypassed if firmware is not found in the specified path

config PROCD_LTQ_SPECIFIC_EXPORT_PATH
	bool 'Export ENV variables'
	default n
	help
		Lantiq specific PATH and LD_LIBRARY_PATH will be exported
```

## ugw/feeds_opensrc/packages/samba3/Config.in
```kconfig
config SAMBA3_DEBUG 
	bool "Enable Logging for samba3"
	depends on PACKAGE_samba3
	default n
```
